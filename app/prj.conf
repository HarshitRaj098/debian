## CMakeLists.txt
```
cmake_minimum_required(VERSION 3.20.0)
find_package(Zephyr REQUIRED HINTS $ENV{ZEPHYR_BASE})
project(zero_point_mvp)

target_sources(app PRIVATE 
    src/main.c 
    src/entitlement.c 
    src/process.c 
    src/scheduler.c
    src/network.c
    src/storage.c
    src/boot_manager.c
)
```

## prj.conf
```kconfig
# Minimal configuration for ESP32-S3 console output
CONFIG_SERIAL=y
CONFIG_CONSOLE=y
CONFIG_PRINTK=y
```

## src/main.c
```c
#include <zephyr/kernel.h>
#include <zephyr/sys/printk.h>

void main(void)
{
    printk("PHANTOM-Z v0.1 | ZERO-POINT MVP INITIALIZED\n");
    printk("OS: Zephyr RTOS\n");
    printk("TARGET: ESP32-S3\n");
    printk("STATUS: READY\n");
}
```

## src/boot_manager.c
```c
#include "boot_manager.h"
#include "storage.h"
#include <zephyr/logging/log.h>

LOG_MODULE_REGISTER(os_boot, LOG_LEVEL_INF);

static BootState boot_state;
#define BOOT_STATE_PATH "/config/boot"

int boot_manager_init(void) {
    storage_read(BOOT_STATE_PATH, &boot_state, sizeof(BootState));
    
    if (boot_state.crash_count > 3) {
        boot_state.recovery_mode = 1;
        LOG_WRN("High crash count detected! Entering Recovery Mode.");
    }
    
    boot_state.crash_count++;
    storage_write(BOOT_STATE_PATH, &boot_state, sizeof(BootState));
    return 0;
}

void boot_manager_report_success(void) {
    boot_state.crash_count = 0;
    boot_state.last_boot_ok = 1;
    storage_write(BOOT_STATE_PATH, &boot_state, sizeof(BootState));
    LOG_INF("System boot verified.");
}

void boot_manager_report_failure(void) {
    boot_state.last_boot_ok = 0;
    storage_write(BOOT_STATE_PATH, &boot_state, sizeof(BootState));
}

bool boot_manager_in_recovery(void) {
    return boot_state.recovery_mode != 0;
}
```

## src/boot_manager.h
```c
#ifndef BOOT_MANAGER_H
#define BOOT_MANAGER_H

#include <stdint.h>

typedef struct {
    uint32_t last_boot_ok;
    uint32_t crash_count;
    uint32_t recovery_mode;
    uint32_t firmware_version;
} BootState;

int boot_manager_init(void);
void boot_manager_report_success(void);
void boot_manager_report_failure(void);
bool boot_manager_in_recovery(void);

#endif
```

## src/process.c
```c
#include "process.h"
#include <zephyr/kernel.h>
#include <string.h>

static pcb_t process_table[MAX_PROCESSES];
static uint8_t current_pid = 0;

void process_init(void) {
    memset(process_table, 0, sizeof(process_table));
    // PID 0 is always the Kernel
    process_table[0].pid = 0;
    process_table[0].state = PROC_STATE_RUNNING;
    strcpy(process_table[0].name, "KERNEL");
}

int process_spawn(const char *name, capability_t cap) {
    for (int i = 1; i < MAX_PROCESSES; i++) {
        if (process_table[i].state == PROC_STATE_TERMINATED || process_table[i].pid == 0) {
            process_table[i].pid = i;
            process_table[i].state = PROC_STATE_READY;
            process_table[i].required_capability = cap;
            strncpy(process_table[i].name, name, 15);
            return i;
        }
    }
    return -1; // Table full
}

pcb_t* process_get_current(void) {
    return &process_table[current_pid];
}
```

## src/process.h
```c
#ifndef PROCESS_H
#define PROCESS_H

#include <stdint.h>
#include "entitlement.h"

typedef enum {
    PROC_STATE_READY,
    PROC_STATE_RUNNING,
    PROC_STATE_BLOCKED,
    PROC_STATE_TERMINATED
} proc_state_t;

typedef struct {
    uint8_t pid;
    proc_state_t state;
    uint32_t memory_base;
    uint32_t memory_limit;
    uint32_t cpu_time;
    capability_t required_capability; // Entitlement linkage
    char name[16];
} pcb_t;

#define MAX_PROCESSES 8

void process_init(void);
int process_spawn(const char *name, capability_t cap);
pcb_t* process_get_current(void);

#endif
```

## src/scheduler.c
```c
#include "scheduler.h"
#include "entitlement.h"
#include <zephyr/logging/log.h>

LOG_MODULE_REGISTER(os_sched, LOG_LEVEL_INF);

void scheduler_init(void) {
    LOG_INF("Scheduler active.");
}

void scheduler_tick(void) {
    // Basic Round-Robin foundation
    pcb_t* current = process_get_current();
    
    // In a real system, this would trigger a context switch
    // Here we check if the current process still has entitlement
    if (current->pid != 0) { // If not kernel
        if (!entitlement_has_capability(current->required_capability)) {
            LOG_WRN("Process %s lost entitlement. Terminating.", current->name);
            current->state = PROC_STATE_TERMINATED;
        }
    }
}
```

## src/scheduler.h
```c
#ifndef SCHEDULER_H
#define SCHEDULER_H

#include "process.h"

void scheduler_init(void);
void scheduler_tick(void);

#endif
```
